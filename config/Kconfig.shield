## config/Kconfig.shield
```kconfig
config SHIELD_DIGBOARD_LEFT
    def_bool $(shields_list_contains,digboard_left)

config SHIELD_DIGBOARD_RIGHT
    def_bool $(shields_list_contains,digboard_right)
```
